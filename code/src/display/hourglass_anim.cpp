#include "display/hourglass_anim.h"

static const uint32_t FRAME_INTERVAL_MS = 400;
static const uint8_t  FRAME_COUNT       = 7;
static const uint8_t  ICON_SIZE         = 24;


static const unsigned char _hourglass_frame_0[] PROGMEM = {0x00,0x00,0x00,0xe0,0xff,0x0f,0x20,0x00,0x08,0xc0,0xff,0x07,0x80,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0x00,0x00};
static const unsigned char _hourglass_frame_1[] PROGMEM = {0x00,0x00,0x00,0xe0,0xff,0x0f,0x20,0x00,0x08,0xc0,0xff,0x07,0x80,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0x00,0x00};
static const unsigned char _hourglass_frame_2[] PROGMEM = {0x00,0x00,0x00,0xe0,0xff,0x0f,0x20,0x00,0x08,0xc0,0xff,0x07,0x80,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0x00,0x00};
static const unsigned char _hourglass_frame_3[] PROGMEM = {0x00,0x00,0x00,0xe0,0xff,0x0f,0x20,0x00,0x08,0xc0,0xff,0x07,0x80,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0x00,0x00};
static const unsigned char _hourglass_frame_4[] PROGMEM = {0x00,0x02,0x00,0x00,0x07,0x00,0x80,0x02,0x00,0x40,0x05,0x00,0xa0,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0x40,0x00};
static const unsigned char _hourglass_frame_5[] PROGMEM = {0x00,0x00,0x00,0x00,0x00,0x00,0x00,0x00,0x00,0x00,0x00,0x00,0x00,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0x00,0x00};
static const unsigned char _hourglass_frame_6[] PROGMEM = {0x00,0x40,0x00,0x00,0xe0,0x00,0x00,0x40,0x01,0x00,0xa0,0x02,0x00,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0x02,0x00};


static const unsigned char* const _frames[FRAME_COUNT] = {
    _hourglass_frame_0, _hourglass_frame_1, _hourglass_frame_2, _hourglass_frame_3,
    _hourglass_frame_4, _hourglass_frame_5, _hourglass_frame_6
};


static uint8_t  _frameIndex = 0;
static uint32_t _lastFrameMs = 0;
static bool     _wasActive = false;


void hourglassAnimDraw(U8G2& display, bool active) {
    if (!active) {
        _wasActive = false;
        return;
    }

    uint32_t now = millis();

    if (!_wasActive) {
        _frameIndex = 0;
        _lastFrameMs = now;
        _wasActive = true;
    } else if (now - _lastFrameMs >= FRAME_INTERVAL_MS) {
        _lastFrameMs = now;
        _frameIndex = (_frameIndex + 1) % FRAME_COUNT;
    }

    display.drawXBMP(0, 0, ICON_SIZE, ICON_SIZE, _frames[_frameIndex]);
}